## drivers/iio/Kconfig
```kconfig
#
# Industrial I/O subsystem
#

menuconfig IIO
	tristate "Industrial I/O support"
	depends on GENERIC_HARDIRQS
	help
	  The Industrial input / output subsystem provides a unified
	  framework for many different types of embedded sensor.

if IIO

config IIO_HWMON
       tristate "Hwmon driver that uses channels specified via iio maps"
       depends on HWMON
       help
	  This is a platform driver that in combination with a suitable
	  map allows IIO devices to provide  basic hwmon functionality
	  for those channels specified in the map.

source "drivers/iio/adc/Kconfig"
source "drivers/iio/imu/Kconfig"
source "drivers/iio/light/Kconfig"

endif # IIO
```

## drivers/iio/adc/Kconfig
```kconfig
#
# ADC drivers
#
menu "Analog to digital convertors"

config IIO_MAX1363
	tristate "Maxim max1363 ADC driver"
	depends on I2C
	help
	  Say yes here to build support for many Maxim i2c analog to digital
	  convertors (ADC). (max1361, max1362, max1363, max1364, max1036,
	  max1037, max1038, max1039, max1136, max1136, max1137, max1138,
	  max1139, max1236, max1237, max11238, max1239, max11600, max11601,
	  max11602, max11603, max11604, max11605, max11606, max11607,
	  max11608, max11609, max11610, max11611, max11612, max11613,
	  max11614, max11615, max11616, max11617, max11644, max11645,
	  max11646, max11647) Provides direct access via sysfs.

endmenu
```

## drivers/iio/imu/Kconfig
```kconfig
menu "Inertial measurement units (IMUs)"

config IIO_ADIS16400
	tristate "Analog Devices ADIS16400 and similar IMU SPI driver"
	depends on SPI
	help
	  Say yes here to build support for Analog Devices adis16300, adis16350,
	  adis16354, adis16355, adis16360, adis16362, adis16364, adis16365,
	  adis16400 and adis16405 triaxial inertial sensors (adis16400 series
	  also have magnetometers).

endmenu
```

## drivers/iio/light/Kconfig
```kconfig
#
# IIO Light Sensor Drivers
#
menu "Light Sensors"

config IIO_TSL2563
tristate "TAOS TSL2560, TSL2561, TSL2562 and TSL2563 ambient light sensors"
	depends on I2C
	help
	 If you say yes here you get support for the Taos TSL2560,
	 TSL2561, TSL2562 and TSL2563 ambient light sensors.

	 This driver can also be built as a module.  If so, the module
	 will be called iio_tsl2563.

endmenu
```
